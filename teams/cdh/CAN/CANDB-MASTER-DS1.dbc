VERSION ""

NS_ :

BS_:

BU_: ppt adcs_batt eps_dist eps_gen adcs_rwz adcs_rwy adcs_rwx adcs_mtq rahs adcs_sensorproc adcs_mpc adcs_estim adcs_bdot com_1 com_2

BO_ 0 sync_2: 0 eps_gen

BO_ 2148663295 sync_1: 0 ppt

BO_ 2417188864 msp_temp: 3 rahs
 SG_ msp_temp_temp : 0|16@1+ (1,0) [0|65535] "dK" Vector__XXX

BO_TX_BU_ 2417188864 : adcs_batt,adcs_bdot,adcs_estim,adcs_mpc,adcs_mtq,adcs_rwx,adcs_rwy,adcs_rwz,adcs_sensorproc,com_1,com_2,eps_dist,eps_gen,ppt,rahs;

BA_DEF_  "BusType" STRING ;
BA_DEF_DEF_  "BusType" "CAN";
